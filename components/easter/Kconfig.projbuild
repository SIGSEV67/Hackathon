## components/easter/Kconfig.projbuild
```kconfig
menu "SIGSEV: easter egg"

    config SIGSEV_EASTER_EGG
        bool "Konami code: the kiwi dances \"6 7\", explodes and reboots the whole mesh"
        default y
        help
            Up Up Down Down Left Right Left Right KEY2 KEY2 on the board (or
            tools/konami.py over USB) plays the animation, and when the kiwi
            explodes every other board plays it too and then they all reboot.

            Any board can reboot the whole network with this: turn it off for
            real use. With it off the board ignores the packet (it still
            forwards it, like any other).

endmenu
```

## components/mesh/Kconfig.projbuild
```kconfig
menu "SIGSEV: mesh"

    config SIGSEV_MESH_TTL
        int "Max hops per packet (TTL)"
        range 1 15
        default 6

    config SIGSEV_MESH_FORWARD_JITTER_MS
        int "Max random delay before forwarding (ms)"
        range 0 50
        default 8
        help
            Nodes that hear the same packet wait a random time before
            re-broadcasting it, so their forwards don't collide on air.

    config SIGSEV_MESH_NEIGHBOR_TIMEOUT_S
        int "Seconds without hearing a neighbor before dropping it"
        range 3 120
        default 15

endmenu
```

## components/messages/Kconfig.projbuild
```kconfig
menu "SIGSEV: messages"

    config SIGSEV_VOICE_MAX_S
        int "Max voice message length (seconds)"
        range 2 60
        default 20

    config SIGSEV_VOICE_STORE_KB
        int "Memory for stored voice messages (KB)"
        default 4096 if SPIRAM
        default 96
        help
            Oldest messages are dropped when this fills up. Voice is IMA ADPCM
            at 8 kHz, about 4 KB per second.

    config SIGSEV_VOICE_GAIN_MAX
        int "Max playback gain (x)"
        range 1 32
        default 8
        help
            Playback normalizes each message to full scale, up to this gain.

endmenu
```

## components/periph/Kconfig.projbuild
```kconfig
menu "SIGSEV: hardware (periph)"

    config HACK_SPEAKER_ENABLE
        bool "Enable speaker (I2S1)"
        default y
        help
            Drive an I2S amplifier (MAX98357A or similar) for voice playback
            and calls. With nothing connected the pins just toggle, so it is
            safe to leave on. When disabled, playback returns
            ESP_ERR_NOT_SUPPORTED. The PDM microphone on I2S0 works either way.

    config HACK_SPEAKER_DIN_GPIO
        int "Speaker DIN GPIO"
        depends on HACK_SPEAKER_ENABLE
        default 4

    config HACK_SPEAKER_BCLK_GPIO
        int "Speaker BCLK GPIO"
        depends on HACK_SPEAKER_ENABLE
        default 5

    config HACK_SPEAKER_LRCLK_GPIO
        int "Speaker LRCLK (WS) GPIO"
        depends on HACK_SPEAKER_ENABLE
        default 6

    config HACK_SPEAKER_VOLUME
        int "Speaker volume (percent of full scale)"
        depends on HACK_SPEAKER_ENABLE
        range 1 100
        default 40
        help
            Scale applied to everything that goes to the speaker. Voices are
            already normalized to near full scale. The MAX98357A is loud,
            keep it low when testing at a desk.

    config HACK_DISPLAY_ROTATE_180
        bool "Rotate display by 180 degrees"
        default n
        help
            Enable if the text on the OLED appears upside down.

endmenu
```

## components/radio/Kconfig.projbuild
```kconfig
menu "SIGSEV: radio"

    config SIGSEV_RADIO_CHANNEL
        int "WiFi channel"
        range 1 13
        default 6
        help
            Every node must use the same channel: the softAP (for phones) and
            ESP-NOW (for the mesh) share the radio and its channel.

    config SIGSEV_RADIO_MAX_CLIENTS
        int "Max phones connected per node"
        range 1 10
        default 4

endmenu
```

## components/ranging/Kconfig.projbuild
```kconfig
menu "SIGSEV: ranging"

    config SIGSEV_RANGING_FTM_OFFSET_CM
        int "FTM distance offset (cm)"
        range -10000 10000
        default 0
        help
            Subtracted from every FTM measurement. Calibrate it by putting two
            boards at a known distance (say 1 m) and setting this to the
            measured distance minus the real one.

    config SIGSEV_RANGING_RSSI_AT_1M
        int "RSSI at 1 m (dBm), for the RSSI estimate"
        range -90 -10
        default -45

    config SIGSEV_RANGING_PATH_LOSS_X10
        int "Path loss exponent x10, for the RSSI estimate"
        range 15 60
        default 27
        help
            2.0 is free space; 2.7 to 3.5 is typical outdoors with people around,
            and higher indoors.

endmenu
```

## main/Kconfig.projbuild
```kconfig
menu "Hackathon board demo"

    config HACK_SPEAKER_ENABLE
        bool "Enable speaker (I2S1)"
        default n
        help
            Initialize the MAX98357A speaker on I2S1 (DIN=4, BCLK=5, LRCLK=6).
            When disabled audio_play_tone() is a no-op. The PDM microphone
            on I2S0 works either way.

    config HACK_SPEAKER_VOLUME
        int "Speaker volume (percent of full scale)"
        depends on HACK_SPEAKER_ENABLE
        range 1 100
        default 25
        help
            Peak amplitude of generated tones. The MAX98357A is loud even at
            low values, keep it low when testing at a desk.

    config HACK_DISPLAY_ROTATE_180
        bool "Rotate display by 180 degrees"
        default n
        help
            Enable if the text on the OLED appears upside down.

endmenu
```
